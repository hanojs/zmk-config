## config/boards/shields/ErgoMax/Kconfig.shield
```kconfig
config SHIELD_ERGOMAX_LEFT
    def_bool $(shields_list_contains,my_board_left)

config SHIELD_ERGOMAX_RIGHT
    def_bool $(shields_list_contains,my_board_right)
```

## config/boards/shields/ergomax/Kconfig.defconfig
```kconfig
if SHIELD_ERGOMAX_LEFT

config ZMK_KEYBOARD_NAME
    default "ErgoMax"

config ZMK_SPLIT_BLE_ROLE_CENTRAL
    default y

endif

if SHIELD_ERGOMAX_LEFT || SHIELD_ERGOMAX_RIGHT

config ZMK_SPLIT
    default y

endif
```

## config/boards/shields/ergomax/Kconfig.shield
```kconfig
config SHIELD_ERGOMAX_LEFT
    def_bool $(shields_list_contains,ergomax_left)

config SHIELD_ERGOMAX_RIGHT
    def_bool $(shields_list_contains,ergomax_right)
```
